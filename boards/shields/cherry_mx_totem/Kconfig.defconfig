## boards/shields/cherry_mx_totem/Kconfig.defconfig
```kconfig
if SHIELD_CHERRY_MX_TOTEM_LEFT

config ZMK_KEYBOARD_NAME
    default "Cherry MX Totem"

config ZMK_SPLIT_ROLE_CENTRAL
    default y

endif

if SHIELD_CHERRY_MX_TOTEM_LEFT || SHIELD_CHERRY_MX_TOTEM_RIGHT

config ZMK_SPLIT
    default y

endif
```

## boards/shields/cherry_mx_totem/Kconfig.shield
```kconfig
config SHIELD_CHERRY_MX_TOTEM_LEFT
    def_bool $(shields_list_contains,cherry_mx_totem_left)

config SHIELD_CHERRY_MX_TOTEM_RIGHT
    def_bool $(shields_list_contains,cherry_mx_totem_right)
```
